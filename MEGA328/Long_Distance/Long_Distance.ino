#define ARR_MAX 2000  //加减速步数
const unsigned short AccStep[ARR_MAX]PROGMEM=
{
1560,1560,1560,1560,1560,1558,1558,1558,1558,1558,
1555,1555,1555,1555,1553,1553,1553,1553,1553,1550,
1550,1550,1550,1548,1548,1548,1548,1548,1546,1546,
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151,151,151,151,151,151,151,151,151,151,
} ;//生成的加减速数组
// PROGMEM

//LED: PB4/PB5/PC2/PC3
#define Set_Bit(val, bitn)    (val |=(1<<(bitn)))
#define Clr_Bit(val, bitn)     (val&=~(1<<(bitn)))
#define Get_Bit(val, bitn)    (val &(1<<(bitn)) )
//MS PD2/3/4
//SETP PD6,PWM接口
//DIR PD5
//EN PB0
//LIMIT PB1
#define DEV_ID 0x01

#define LedRed1 Set_Bit(PORTB,4);Set_Bit(PORTC,3)
#define LedRed0 Clr_Bit(PORTB,4);Clr_Bit(PORTC,3)
#define LedGreen1 Set_Bit(PORTB,5);Set_Bit(PORTC,2)
#define LedGreen0 Clr_Bit(PORTB,5);Clr_Bit(PORTC,2)

#define Limit (PINB & 0x02) == 0x02
#define DisableMotor Set_Bit(PORTB,0)
#define EnableMotor Clr_Bit(PORTB,0)

#define MotorP1 Set_Bit(PORTD,6)
#define MotorP0 Clr_Bit(PORTD,6)
#define MotorD1 Set_Bit(PORTD,5)
#define MotorD0 Clr_Bit(PORTD,5)
#define MS1_1 Set_Bit(PORTD,2)
#define MS1_0 Clr_Bit(PORTD,2)
#define MS2_1 Set_Bit(PORTD,3)
#define MS2_0 Clr_Bit(PORTD,3)
#define MS3_1 Set_Bit(PORTD,4)
#define MS3_0 Clr_Bit(PORTD,4)

#define ACCEL   1  //电机运行状态标志位
#define DECEL   2
#define RUN     3
#define STOP   0
unsigned long step_count;  //步数计数
int acc_count;      //加速计数
int dcc_count;      //减速计数
uint8_t flag = STOP;//开始时的状态

int Dir,Speed,Distance;

 void serialEvent()//串口接收
{
  static int aa = 0,i = 0;
  int Rec,Val,Buff[10];
  while(Serial.available())
  {
    Rec = Serial.read();
    if(Rec == 0xaa)//接收第一个字节 起始位
      aa=0x80;
    if(aa==0x80)
      Buff[i++]=Rec;
    if((i==6)&&(Buff[5]==0xff))//校验终止位
    {
      i=0;
      aa=0;
      Val = Buff[1]+Buff[2]+Buff[3];
      if(Val == Buff[4])
      {
        Dir = Buff[1];
        Speed = Buff[2];
        Distance = Buff[3];
      }
    }
  }
  flag = ACCEL; //等到下一个数据进入后进入加速状态
  EnableMotor;//使能电机
  SetSteps(Dir,Distance);//设置电机方向和步数
}
void setup()//初始化
{
  DDRC = 0xff;//c端口初始化为输出
  DDRB = 0xff;
  PORTB = 0xff;//b端口初始化为高电平
  LedGreen1;
  LedRed0;
  DisableMotor;//驱动失能
  MS1_0;
  MS2_1;
  MS3_0;//
  Serial.begin(4800);
}
void SetSteps(int DIR,unsigned int DISTANCE)//运行步数
{
  if(DIR>0)
    MotorD0;      //设定电机运行方向
  else
    MotorD1;
  step_count = (DISTANCE*2000);
  
}
int Time = 0,NowTime = 0;
void Pulse()//产生脉冲
{
  switch(flag)  //查询状态
  {
    case STOP  :
  {
      acc_count =0;
      step_count = 0;
      dcc_count = ARR_MAX-1;
    DisableMotor;//电机失能
    }break;
    
    case ACCEL :
  {
      acc_count++;
      step_count--;
    
      MotorP1; //输出一个脉冲
    delayMicroseconds(20);
      MotorP0;
    
      NowTime =  pgm_read_word_near(&AccStep[acc_count])*5;//查表
      if(acc_count == ARR_MAX-1) 
      flag = RUN;
    }break;
 
    case RUN   :
  {
      step_count--;
    
      MotorP1; //输出一个脉冲
    delayMicroseconds(20);
      MotorP0;
    NowTime =  pgm_read_word_near(&AccStep[ARR_MAX-1])*5;//查表
      if(step_count == ARR_MAX-1) //减到进入减速步数范围
      {
        flag = DECEL;
      } 
    }break;
    case DECEL :
  {
      dcc_count--;
      step_count--;
      
      MotorP1; //输出一个脉冲
    delayMicroseconds(20);
      MotorP0;

      
      NowTime =  pgm_read_word_near(&AccStep[dcc_count])*5;
      if(acc_count == 0 || step_count==0)
    {     
      flag = STOP;
    }
    }break;
  }
}
void loop() 
{

    while(NowTime--);
    Pulse();//产生脉冲函数
}
